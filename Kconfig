## Kconfig
```kconfig
# Module-level Kconfig — injected into Zephyr's Kconfig tree
# via zephyr/module.yml. Shows up under:
#   Zephyr > Modules > zephyr_nxp

rsource "drivers/Kconfig"
rsource "lib/Kconfig"
```

## drivers/Kconfig
```kconfig
menu "Custom drivers"
# rsource driver Kconfig files here, e.g.:
# rsource "my_driver/Kconfig"
endmenu
```

## lib/Kconfig
```kconfig
menu "Custom libraries"
# rsource library Kconfig files here, e.g.:
# rsource "my_lib/Kconfig"
endmenu
```
